## components/frame/Kconfig.projbuild
```kconfig
menu "Frame Configuration"

    config FRM_LOG_LEVEL
        int "Frame LOG LEVEL"
        range 0	5
        default 2
        help
        	Set LOG Level for FRAME module
        	0=None
        	1=Error
        	2=Warn
        	3=Info
        	4=Debug
        	5=Verbose

    config FRM_MIN_TX_DELAY
        int "Minimum delay before TX (mS)"
        range 0 100
        default	50
        help
            Specifies the minimum delay after any RX or TX frame before next TX

    config FRM_MAX_CAL_INTERVAL
        int "Maximum interval between cc1101 calibrations (sec)"
        range 0 300
        default	30
        help
            Specifies the maximum interval between cc1101 calibrations

    config FRM_RX_TIMEOUT
        int "Abort an RX frame that has not completed after (mS)"
        range 50 2000
        default 200

    config FRM_TX_TIMEOUT
        int "Abort a TX frame that has not completed after (mS)"
        range 100 5000
        default 500

    config FRM_RX_WATCHDOG_MIN
        int "Restart if no RF frame received for (minutes, 0=off)"
        range 0 120
        default 5

    config UART_LOG_LEVEL
        int "UART LOG LEVEL"
        range 0	5
        default 2
        help
        	Set LOG Level for UART module
        	0=None
        	1=Error
        	2=Warn
        	3=Info
        	4=Debug
        	5=Verbose

endmenu
```
